#include <list>
#include <stdlib.h>
#include <time.h>
#include <stdio.h>
#include <stm32l4xx_ll_usart.h>
#include <stm32l4xx_ll_rtc.h>

void std::__detail::_List_node_base::_M_hook(std::__detail::_List_node_base *const __position) _GLIBCXX_USE_NOEXCEPT
{
    this->_M_next = __position;
    this->_M_prev = __position->_M_prev;
    __position->_M_prev->_M_next = this;
    __position->_M_prev = this;
}

void std::__detail::_List_node_base::_M_unhook() _GLIBCXX_USE_NOEXCEPT
{
    _M_prev->_M_next = this->_M_next;
    _M_next->_M_prev = this->_M_prev;
}

extern "C" void __cxa_pure_virtual()
{
    while (true);
}

void *operator new(size_t size)
{
    return malloc(size);
}

void operator delete(void *obj, unsigned int size)
{
    free(obj);
}

void operator delete(void *obj)
{
    free(obj);
}

extern "C" int _write(int fd, char *ptr, int len)
{
    for (int i = 0; i < len; i++)
    {
        // 把打印信息存储起来
        LL_USART_TransmitData8(USART1, ptr[i]);
        while (!LL_USART_IsActiveFlag_TC(USART1));
    }
    return len;
}

const uint8_t crc16_high_table[] =
    {
        0x00, 0xC1, 0x81, 0x40, 0x01, 0xC0, 0x80, 0x41, 0x01, 0xC0,
        0x80, 0x41, 0x00, 0xC1, 0x81, 0x40, 0x01, 0xC0, 0x80, 0x41,
        0x00, 0xC1, 0x81, 0x40, 0x00, 0xC1, 0x81, 0x40, 0x01, 0xC0,
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        0x80, 0x41, 0x00, 0xC1, 0x81, 0x40};

/* crc16 低位字节值表 */
const uint8_t crc16_low_table[] =
    {
        0x00, 0xC0, 0xC1, 0x01, 0xC3, 0x03, 0x02, 0xC2, 0xC6, 0x06,
        0x07, 0xC7, 0x05, 0xC5, 0xC4, 0x04, 0xCC, 0x0C, 0x0D, 0xCD,
        0x0F, 0xCF, 0xCE, 0x0E, 0x0A, 0xCA, 0xCB, 0x0B, 0xC9, 0x09,
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        0x43, 0x83, 0x41, 0x81, 0x80, 0x40};

/**
 * \brief   crc16校验
 * \param   buf 校验buf
 * \param   len 校验长度
 * \return  crc16校验值(如果传入buf包含crc字节，返回0)
 */
uint16_t crc16(uint8_t *buf, uint16_t len)
{
    uint8_t low = 0xFF;
    uint8_t high = 0xFF;
    uint16_t index; /* CRC循环中的索引 */
    while (len--)
    {
        index = low ^ *buf++; /* 计算CRC */
        low = high ^ crc16_high_table[index];
        high = crc16_low_table[index];
    }
    return uint16_t(high) << 8 | uint16_t(low);
}


time_t RTC_Get_Time(tm& time_struct)
{
    uint32_t temp_time = 0;
    temp_time = LL_RTC_DATE_GetYear(RTC);
    temp_time = (uint8_t)(((temp_time >> 4) * 10) + (temp_time & 0x0000000f));
    time_struct.tm_year=(uint8_t)temp_time+100;

    temp_time = LL_RTC_DATE_GetMonth(RTC);
    temp_time = (uint8_t)(((temp_time >> 4) * 10) + (temp_time & 0x0000000f));
    time_struct.tm_mon=(uint8_t)temp_time-1;

    temp_time = LL_RTC_DATE_GetDay(RTC);
    temp_time = (uint8_t)(((temp_time >> 4) * 10) + (temp_time & 0x0000000f));
    time_struct.tm_mday=(uint8_t)temp_time;

    temp_time = LL_RTC_TIME_GetHour(RTC);
    temp_time = (uint8_t)(((temp_time >> 4) * 10) + (temp_time & 0x0000000f));
    time_struct.tm_hour = (uint8_t)temp_time; // 时

    temp_time = LL_RTC_TIME_GetMinute(RTC);
    temp_time = (uint8_t)(((temp_time >> 4) * 10) + (temp_time & 0x0000000f));
    time_struct.tm_min = (uint8_t)temp_time; // 分

    temp_time = LL_RTC_TIME_GetSecond(RTC);
    temp_time = (uint8_t)(((temp_time >> 4) * 10) + (temp_time & 0x0000000f));
    time_struct.tm_sec = (uint8_t)temp_time; // 秒

    printf("RTC_Time:%d-%d-%d %d:%d:%d\n",time_struct.tm_year+1900,time_struct.tm_mon,time_struct.tm_mday,time_struct.tm_hour,time_struct.tm_min,time_struct.tm_sec);//输出闹铃时间
    return mktime(&time_struct);
}

#define RTC_BKP_DATE_TIME_UPDATED ((uint32_t)0x32F2)
void RTC_Set(tm& time_struct)
{
    // LL_RTC_DateTypeDef date={
    //     .Month=uint8_t(time_struct.tm_mon+1),    
    //     .Day=uint8_t(time_struct.tm_mday),            
    //     .Year=uint8_t(time_struct.tm_year-100)
    // };
    // LL_RTC_TimeTypeDef time={
    //     .Hours=uint8_t(time_struct.tm_hour),
    //     .Minutes=uint8_t(time_struct.tm_min),
    //     .Seconds=uint8_t(time_struct.tm_sec)
    // };
    // printf("%d %d %d\n", date.Year,date.Month,date.Day);
    // LL_RTC_DATE_Init(TAMP, LL_RTC_FORMAT_BIN, &date);
    // LL_RTC_TIME_Init(TAMP, LL_RTC_FORMAT_BIN, &time);
    // LL_RTC_BKP_SetRegister(RTC, LL_RTC_BKP_DR0, RTC_BKP_DATE_TIME_UPDATED);
}
#include <stdarg.h>
#include <stdio.h>
#include <string.h>
// 多串口Printf函数
extern "C" void USART_Printf(USART_TypeDef *USARTx, const char *fmt, ...) {
    char buffer[256]={0};
    va_list args;
    va_start(args, fmt);
    vsnprintf(buffer, sizeof(buffer), fmt, args);
    va_end(args);
// 等待上一次传输完成
    while (!LL_USART_IsActiveFlag_TC(USARTx));
    
    for (uint16_t i = 0; buffer[i] != '\0'; i++) {
        LL_USART_TransmitData8(USARTx, buffer[i]);
        while (!LL_USART_IsActiveFlag_TXE(USARTx)); // 等待发送缓冲区空
    }
    
    // 等待传输完全完成
    while (!LL_USART_IsActiveFlag_TC(USARTx));
}